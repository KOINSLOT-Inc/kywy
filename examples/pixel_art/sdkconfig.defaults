## examples/pixel_art/sdkconfig.defaults
```kconfig
# SPDX-FileCopyrightText: 2023 KOINSLOT, Inc.
#
# SPDX-License-Identifier: GPL-3.0-or-later

CONFIG_IDF_TARGET="linux"
CONFIG_ESP_TASK_WDT_EN=n
```
